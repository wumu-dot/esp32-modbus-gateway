## main/Kconfig.projbuild
```kconfig
menu "ESP32 Modbus Gateway Configuration"

    config MB_UART_PORT_ONE
        bool
        default y
        depends on (ESP_CONSOLE_UART_NUM !=1) && (SOC_UART_HP_NUM > 1)

    config MB_UART_PORT_TWO
        bool
        default y
        depends on (ESP_CONSOLE_UART_NUM !=2) && (SOC_UART_HP_NUM > 2)

    config MB_UART_PORT_NUM
        int "UART port number"
        range 0 2 if MB_UART_PORT_TWO
        default 2 if MB_UART_PORT_TWO
        range 0 1 if MB_UART_PORT_ONE
        default 1 if MB_UART_PORT_ONE
        help
            UART communication port number for Modbus (RS485).

    config MB_UART_BAUD_RATE
        int "UART communication speed"
        range 1200 115200
        default 115200
        help
            UART communication speed for Modbus (RS485).

    config MB_UART_RXD
        int "UART RXD pin number"
        range 0 34 if IDF_TARGET_ESP32
        default 16 if IDF_TARGET_ESP32
        range 0 48 if IDF_TARGET_ESP32S3
        default 16 if IDF_TARGET_ESP32S3
        help
            GPIO number for UART RX pin (MAX3485 RO).

    config MB_UART_TXD
        int "UART TXD pin number"
        range 0 34 if IDF_TARGET_ESP32
        default 17 if IDF_TARGET_ESP32
        range 0 48 if IDF_TARGET_ESP32S3
        default 17 if IDF_TARGET_ESP32S3
        help
            GPIO number for UART TX pin (MAX3485 DI).

    config MB_UART_RTS
        int "UART RTS pin number"
        range 0 34 if IDF_TARGET_ESP32
        default 19 if IDF_TARGET_ESP32
        range 0 48 if IDF_TARGET_ESP32S3
        default 10 if IDF_TARGET_ESP32S3
        help
            GPIO number for UART RTS pin. Connected to ~RE/DE of RS485
            transceiver (MAX3485). RS485 half-duplex direction is driven
            automatically by UART hardware (GW-07).

    choice MB_COMM_MODE
        prompt "Modbus communication mode"
        default MB_COMM_MODE_RTU if CONFIG_FMB_COMM_MODE_RTU_EN

        config MB_COMM_MODE_RTU
            bool "RTU mode"
            depends on FMB_COMM_MODE_RTU_EN

        config MB_COMM_MODE_ASCII
            bool "ASCII mode"
            depends on FMB_COMM_MODE_ASCII_EN

    endchoice

    config MB_WIFI_SSID
        string "WiFi SSID (STA connects to hotspot)"
        default "SET_VIA_MENUCONFIG"
        help
            SSID of the hotspot the gateway STA connects to.

    config MB_WIFI_PASS
        string "WiFi password"
        default ""
        help
            WPA2/PSK password of the hotspot. Leave empty for open network.

    config MB_WIFI_MAX_RETRY
        int "WiFi STA connect max retries"
        default 10
        help
            Max reconnect attempts after STA disconnect before giving up.

    config MB_MQTT_BROKER_URI
        string "MQTT broker URI"
        default "mqtt://YOUR-ENDPOINT.iot-api.com:1883"
        help
            Broker address. For ThingsCloud: mqtt://<endpoint>:1883
            (endpoint from Console -> Device -> Connection page).

    config MB_MQTT_USERNAME
        string "MQTT username"
        default ""
        help
            ThingsCloud: device AccessToken (per-device, from the
            Device -> Connection page). NOT the project-API AccessToken.

    config MB_MQTT_PASSWORD
        string "MQTT password"
        default ""
        help
            ThingsCloud: ProjectKey (shared by all devices in the project).

    config MB_MQTT_TOPIC
        string "MQTT publish topic"
        default "attributes"
        help
            ThingsCloud: publish attributes to 'attributes'.
            Legacy local broker: esp32gw/sounddog/holding

    # ---- FEAT-ESPGW-05：下行控制 ----

    config MB_MQTT_TOPIC_CMD
        string "MQTT command (downlink) topic"
        default "attributes/push"
        help
            Topic the gateway SUBSCRIBES to for remote control.
            ThingsCloud: 'attributes/push' (platform -> device).
            Legacy local broker: esp32gw/sounddog/cmd
            Payload format (plain text, no JSON library):
                {"cid":<register 0..4>,"value":<u16>}
            Register 3 (WIN_LEN) is fixed on the slave and is rejected locally.

    config MB_MQTT_TOPIC_ACK
        string "MQTT command ACK topic"
        default "attributes/response"
        help
            Legacy: topic the gateway publishes the write result to.
            ThingsCloud has no per-command ACK topic: the effect of a
            write is observed in the NEXT attribute publish. The gateway
            therefore logs the ACK locally instead of publishing it
            (publishing an undefined key would be rejected with 406).

    config MB_MQTT_PUBLISH_PERIOD_S
        int "Minimum MQTT attribute publish interval (seconds)"
        range 1 3600
        default 30
        help
            Minimum interval between attribute uploads. Modbus polling stays
            at 1 s; only the cloud publish is throttled.

            ThingsCloud data processing agreement section 3.2.3:
              free-tier devices: >= 30 s between uploads
              paid-tier devices: >= 5 s between uploads
            Publishing faster than the platform limit may cause the broker
            to close the connection.

endmenu
```
